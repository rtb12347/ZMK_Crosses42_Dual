## config/west.yml
```yaml
manifest:
  defaults:
    revision: v0.3
  remotes:
    - name: zmkfirmware
      url-base: https://github.com/zmkfirmware
    - name: Good-Great-Grand-Wonderful
      url-base: https://github.com/Good-Great-Grand-Wonderful
    - name: rtb12347
      url-base: https://github.com/rtb12347
  projects:
    - name: zmk
      remote: zmkfirmware
      import: app/west.yml
    - name: gggw-zmk-keebs
      remote: rtb12347
      revision: main
      import: config/west.yml
  self:
    path: config
```
